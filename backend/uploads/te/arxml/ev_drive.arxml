AUTOSAR XML (schema 4.0)
package /MCU_EV_Drive/System
  system EV_Drive_System: system-version=1.0.0
    ecu instance VCU: category=CONTROLLER
    ecu instance MCU: category=CONTROLLER
    ecu instance BMS: category=CONTROLLER
    can cluster CAN_Cluster_1: baudrate=500000, protocol=CAN
      can physical channel CAN_Channel_1
        can connector VCU_Connector: ecu-instance=VCU
        can connector MCU_Connector: ecu-instance=MCU
package /MCU_EV_Drive/Communication
  4 x can frame, all with frame-length=8:
    VCU_TorqueCmd: pdu=PDU_TorqueCmd
    VCU_SpeedCmd: pdu=PDU_SpeedCmd
    MCU_TorqueFb: pdu=PDU_TorqueFb
    MCU_SpeedFb: pdu=PDU_SpeedFb
package /MCU_EV_Drive/Signals
  8 x system signal:
    Torque_Request: length=16, system-signal-group{type=SIGNED, unit=Nm, factor=0.1, offset=-3276.8, min=-3276.8, max=3276.7}
    Speed_Request: length=16, system-signal-group{type=UNSIGNED, unit=rpm, factor=1, offset=0, min=0, max=15000}
    Torque_Actual: length=16, system-signal-group{type=SIGNED, unit=Nm, factor=0.1, offset=-3276.8, min=-3276.8, max=3276.7}
    Speed_Actual: length=16, system-signal-group{type=UNSIGNED, unit=rpm, factor=1, offset=0, min=0, max=15000}
    IGBT_Temp: length=8, system-signal-group{type=UNSIGNED, unit=C, factor=1, offset=-40, min=-40, max=215}
    Motor_Temp: length=8, system-signal-group{type=UNSIGNED, unit=C, factor=1, offset=-40, min=-40, max=215}
    HV_Voltage: length=16, system-signal-group{type=UNSIGNED, unit=V, factor=0.1, offset=0, min=0, max=6553.5}
    HV_Current: length=16, system-signal-group{type=SIGNED, unit=A, factor=0.1, offset=-3276.8, min=-3276.8, max=3276.7}
package /MCU_EV_Drive/SoftwareComponents
  swc mcu control MCU_Control_Swc: category=APPLICATION
    r port TorqueRequest_RPort: provided-interface=/MCU_EV_Drive/Interfaces/TorqueInterface
    p port TorqueFeedback_PPort: provided-interface=/MCU_EV_Drive/Interfaces/TorqueInterface
